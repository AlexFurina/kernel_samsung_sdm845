## arch/arm64/Kconfig.projects
```kconfig
config SEC_STARQLTE_PROJECT
	depends on ARCH_SDM845
	default n
	bool "Samsung STARQLTE Project"
	help
	  Support for Samsung STARQLTE Project

config MACH_STARQLTE_SINGLE
	depends on SEC_STARQLTE_PROJECT
	default n
	bool "Samsung STARQLTE SQ"
	help
	  Support for Samsung STARQLTE USA SQ device.

config SEC_STAR2QLTE_PROJECT
	depends on ARCH_SDM845
	default n
	bool "Samsung STAR2QLTE Project"
	help
	  Support for Samsung STAR2QLTE Project

config MACH_STAR2QLTE_SINGLE
	depends on SEC_STAR2QLTE_PROJECT
	default n
	bool "Samsung STAR2QLTE SQ"
	help
	  Support for Samsung STAR2QLTE USA SQ device.

config MACH_STARQLTE_CAN_SINGLE
	depends on SEC_STARQLTE_PROJECT
	default n
	bool "Samsung STARQLTE CAN SQ"
	help
	  Support for Samsung STARQLTE CAN SQ device.

config MACH_STAR2QLTE_CAN_SINGLE
	depends on SEC_STAR2QLTE_PROJECT
	default n
	bool "Samsung STAR2QLTE CAN SQ"
	help
	  Support for Samsung STAR2QLTE CAN SQ device.

config MACH_STARQLTE_CHNZC
        depends on SEC_STARQLTE_PROJECT
        default n
        bool "Samsung STARQLTE CHN OPEN"
        help
          Support for Samsung STARQLTE CHN OPEN device.

config MACH_STAR2QLTE_CHNZC
        depends on SEC_STAR2QLTE_PROJECT
        default n
        bool "Samsung STAR2QLTE CHN OPEN"
        help
          Support for Samsung STAR2QLTE CHN OPEN device.

config MACH_STARQLTE_KDI
        depends on SEC_STARQLTE_PROJECT
        default n
        bool "Samsung STARQLTE JPN KDI"
        help
          Support for Samsung STARQLTE JPN KDI device.

config MACH_STAR2QLTE_KDI
        depends on SEC_STAR2QLTE_PROJECT
        default n
        bool "Samsung STAR2QLTE JPN KDI"
        help
          Support for Samsung STAR2QLTE JPN KDI device.

config SEC_CROWNQLTE_PROJECT
	depends on ARCH_SDM845
	default n
	bool "Samsung CROWNQLTE Project"
	help
	  Support for Samsung CROWNQLTE Project

config MACH_CROWNQLTE_USA_SINGLE
	depends on SEC_CROWNQLTE_PROJECT
	default n
	bool "Samsung CROWNQLTE USA SQ"
	help
	  Support for Samsung CROWNQLTE USA SQ device.

config MACH_CROWNQLTE_CHNZC
	depends on SEC_CROWNQLTE_PROJECT
	default n
	bool "Samsung CROWNQLTE CHN OPEN"
	help
	  Support for Samsung CROWNQLTE CHN OPEN device.

config MACH_CROWNQLTE_KDI
        depends on SEC_CROWNQLTE_PROJECT
        default n
        bool "Samsung CROWNQLTE JPN KDI"
        help
          Support for Samsung CROWNQLTE JPN KDI device.
```

## drivers/extremerom/Kconfig
```kconfig
# SPDX-License-Identifier: GPL-2.0

config EXTREMEROM_WORKAROUNDS
	tristate "ExtremeROM workaround framework"
	default n

config ONEUI7_WORKAROUND
	tristate "Multiply brightness value by 100 for OneUI 7 ROM ports"
	select EXTREMEROM_WORKAROUNDS
	default n
```
